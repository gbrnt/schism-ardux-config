## config/boards/arm/schism/Kconfig.board
```kconfig
# Schism board configuration

config BOARD_SCHISM_LEFT
    bool "schism_left"
    depends on SOC_NRF52840_QIAA

config BOARD_SCHISM_RIGHT
    bool "schism_right"
    depends on SOC_NRF52840_QIAA
```

## config/boards/arm/schism/schism_left_defconfig
```kconfig
CONFIG_SOC_SERIES_NRF52X=y
CONFIG_SOC_NRF52840_QIAA=y
CONFIG_BOARD_SCHISM_LEFT=y

# Split central
CONFIG_ZMK_SPLIT=y
CONFIG_ZMK_SPLIT_ROLE_CENTRAL=y

# Tune combos to allow proper Ardux support
CONFIG_ZMK_COMBO_MAX_COMBOS_PER_KEY=16
CONFIG_ZMK_COMBO_MAX_KEYS_PER_COMBO=8
CONFIG_ZMK_COMBO_MAX_PRESSED_COMBOS=8

# Enable deep sleep
CONFIG_ZMK_SLEEP=y

# Reset Bluetooth stuff on start (comment out normally)
#CONFIG_ZMK_BLE_CLEAR_BONDS_ON_START=y

# Enable MPU
CONFIG_ARM_MPU=y

# Enable GPIO
CONFIG_GPIO=y

# Enable OLED
CONFIG_ZMK_DISPLAY=n

# Enable USB logging
#CONFIG_ZMK_USB_LOGGING=y

# Enable writing to flash
CONFIG_USE_DT_CODE_PARTITION=y
CONFIG_MPU_ALLOW_FLASH_WRITE=y
CONFIG_NVS=y
CONFIG_SETTINGS_NVS=y
CONFIG_FLASH=y
CONFIG_FLASH_PAGE_LAYOUT=y
CONFIG_FLASH_MAP=y

CONFIG_CLOCK_CONTROL_NRF=y
CONFIG_CLOCK_CONTROL_NRF_K32SRC_RC=y
```
