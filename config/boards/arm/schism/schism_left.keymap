#include <behaviors.dtsi>
#include <dt-bindings/zmk/keys.h>
#include <dt-bindings/zmk/bt.h>

// Enable ARDUX Big
#define ARDUX_LEFT 1
#define ARDUX_BIG 1

// SW7  SW8  SW9  SW10
// SW13 SW14 SW15 SW16

// ARTS Row
#define KEY_A 10
#define KEY_R 9
#define KEY_T 8
#define KEY_S 7
// EYIO Row
#define KEY_E 16
#define KEY_Y 15
#define KEY_I 14
#define KEY_O 13

// Offsets before and after used keys in matrix, or between rows
#define LEADING_NONES NONE(0, 0, 7)
#define MIDDLE_NONES NONE(0, 0, 2)
#define TRAILING_NONES NONE(0, 1, 3)
#define BIG_LEADING_NONES NONE(0, 0, 7)
#define BIG_BETWEEN_ROW_ONE_TWO_NONES NONE(0, 0, 1)
#define BIG_BETWEEN_ROW_TWO_THREE_NONES NONE(0, 0, 1)
#define BIG_BETWEEN_ROW_THREE_THUMBS NONE(0, 0, 3)
#define BIG_TRAILING_NONES NONE(0, 0, 0)

// Thumb buttons (used for BT combos)
#define THUMB_1 27
#define THUMB_2 28
#define THUMB_3 29

// Function key things that do something
#define KEY_F_TOP 17
#define KEY_F_BOTTOM 23

// Include main ardux.io keymap
#include "../../../ardux.dtsi"

// Test without using Ardux
/*
/ {
  keymap {
    compatible = "zmk,keymap";

    default_layer {
      bindings = <
        &kp N1  &kp N2  &kp N3  &kp N4  &kp N5  &kp N6
        &kp N7  &kp N8  &kp N9  &kp N0  &kp A   &kp B
        &kp C   &kp D   &kp E   &kp F   &kp G   &kp H
        &kp I   &kp J   &kp K   &kp L   &kp M   &kp N
        &kp O   &kp P   &kp Q   &kp R   &kp S   &kp T
      >;
    };
  };
};
*/
